## external/Config.in
```kconfig
#source "$BR2_EXTERNAL/package/sgw/Config.in"
source "../external/package/sgw/Config.in"
```

## external/configs/rpi3_minimal_defconfig
```kconfig
BR2_arm=y
BR2_cortex_a7=y
BR2_ARM_FPU_NEON_VFPV4=y

BR2_TOOLCHAIN_BUILDROOT_GLIBC=y
BR2_PACKAGE_HOST_LINUX_HEADERS_CUSTOM_4_4=y
BR2_TOOLCHAIN_BUILDROOT_CXX=y
BR2_ROOTFS_DEVICE_CREATION_DYNAMIC_EUDEV=y
BR2_SYSTEM_DHCP="eth0"
BR2_TARGET_TZ_INFO=y
BR2_TARGET_LOCALTIME="EST5EDT"
BR2_ROOTFS_OVERLAY="$(BR2_EXTERNAL)/board/rpi3/rootfs_overlay"
BR2_ROOTFS_POST_BUILD_SCRIPT="$(BR2_EXTERNAL)/board/rpi3/post-build.sh"
BR2_ROOTFS_POST_IMAGE_SCRIPT="$(BR2_EXTERNAL)/board/rpi3/post-image.sh"

BR2_LINUX_KERNEL=y
BR2_LINUX_KERNEL_CUSTOM_GIT=y
BR2_LINUX_KERNEL_CUSTOM_REPO_URL="https://github.com/raspberrypi/linux.git"
BR2_LINUX_KERNEL_CUSTOM_REPO_VERSION="25aa8634418934f094e13ac75c902416194d1dbd"
BR2_LINUX_KERNEL_DEFCONFIG="bcm2709"
BR2_LINUX_KERNEL_DTS_SUPPORT=y
BR2_LINUX_KERNEL_INTREE_DTS_NAME="bcm2709-rpi-2-b bcm2710-rpi-3-b bcm2710-rpi-cm3"
BR2_LINUX_KERNEL_DTS_OVERLAYS_SUPPORT=y

BR2_PACKAGE_LINUX_FIRMWARE=y

BR2_PACKAGE_RPI_FIRMWARE=y
BR2_PACKAGE_RPI_FIRMWARE_X=y
BR2_PACKAGE_RPI_WIFI_FIRMWARE=y

BR2_PACKAGE_EXPAT=y
BR2_PACKAGE_IPERF=y
BR2_PACKAGE_IPROUTE2=y
BR2_PACKAGE_IW=y
BR2_PACKAGE_NTP=y
BR2_PACKAGE_WPA_SUPPLICANT=y
BR2_PACKAGE_WPA_SUPPLICANT_AP_SUPPORT=y
BR2_PACKAGE_WPA_SUPPLICANT_WIFI_DISPLAY=y
BR2_TARGET_ROOTFS_EXT2=y
BR2_TARGET_ROOTFS_EXT2_4=y
BR2_PACKAGE_HOST_DOSFSTOOLS=y
BR2_PACKAGE_HOST_GENIMAGE=y
BR2_PACKAGE_HOST_MTOOLS=y
```

## external/package/sgw/Config.in
```kconfig
config BR2_PACKAGE_SGW
	bool "sgw"
	depends on BR2_TOOLCHAIN_HAS_THREADS
        select BR2_PACKAGE_WIRINGPI
	help
          Simple LoRaWAN packet forwarder. This tool forwards acts as 
          a gateway between the LoRaWAN sensors network and The Things
	  Network backend.

          https://github.com/ArnaudPec/single_chan_pkt_fwd

comment "sgw needs pthreads and wiringpi"
	depends on !BR2_TOOLCHAIN_HAS_THREADS
```
